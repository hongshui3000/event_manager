## prj.conf
```kconfig
#
# Copyright (c) 2021 Nordic Semiconductor ASA
#
# SPDX-License-Identifier: Apache-2.0
#
# Enabling assert
CONFIG_ASSERT=y

# Logger configuration

CONFIG_LOG=y
CONFIG_LOG_MODE_MINIMAL=y
CONFIG_LOG_DEFAULT_LEVEL=2
CONFIG_LOG_PRINTK=y
CONFIG_LOG_MODE_IMMEDIATE=y
# Configuration required by Application Event Manager
CONFIG_APP_EVENT_MANAGER=y
CONFIG_HEAP_MEM_POOL_SIZE=2048
CONFIG_MULTITHREADING=n
```

## src/main.c
```c
/*
 * Copyright (c) 2021 Nordic Semiconductor ASA
 *
 * SPDX-License-Identifier: Apache-2.0
 */

#include <app_event_manager.h>
#include <config_event.h>
#include <logging/log.h>

#define MODULE main
LOG_MODULE_REGISTER(MODULE);

#define INIT_VALUE1 3

void main(void)
{
	if (app_event_manager_init()) {
		LOG_ERR("Application Event Manager not initialized");
	} else {
		struct config_event *event = new_config_event();

		event->init_value1 = INIT_VALUE1;
		APP_EVENT_SUBMIT(event);
	}
	while(1){
		app_event_manager_schedule();
	}
}
```
